/dts-v1/;
/plugin/;

&{/chosen} {
        overlays {
                expansion = "gw4x02";
        };
};

&i2c4 {
	#address-cells = <1>;
	#size-cells = <0>;

	eeprom1: eeprom@50 {
		compatible = "atmel,24c64";
		reg = <0x50>;
		pagesize = <32>;
		vcc-supply = <&reg_ldo_misc_3v3>;
	};
};
