/dts-v1/;
/plugin/;

&expansion {
	#address-cells = <1>;
	#size-cells = <1>;

	uart1: serial@30860000 {
		compatible = "fsl,imx7d-uart",
			     "fsl,imx6q-uart";
		reg = <0x30860000 0x10000>;
		status = "okay";
	};
};
